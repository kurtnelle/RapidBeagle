## buildroot/external/Config.in
```kconfig
# RapidBeagle external tree Kconfig hooks.
# Each custom package gets a `source` line below.

menu "RapidBeagle custom packages"

source "$BR2_EXTERNAL_RAPIDBEAGLE_PATH/package/rtl8812au/Config.in"

endmenu
```

## buildroot/external/configs/rapidbeagle_pb_defconfig
```kconfig
# rapidbeagle_pb_defconfig
# Buildroot defconfig for PocketBeagle (AM335x) fast-boot image
# Goal: <10s power-on to NativeAOT dotnet app

# ── Architecture ─────────────────────────────────────────────────────────────
BR2_arm=y
BR2_cortex_a8=y
BR2_ARM_FPU_VFPV3=y
BR2_ARM_INSTRUCTIONS_THUMB2=y

# ── Toolchain ────────────────────────────────────────────────────────────────
# Use Buildroot's internal toolchain with glibc (NativeAOT compatibility).
BR2_TOOLCHAIN_BUILDROOT_GLIBC=y
BR2_TOOLCHAIN_BUILDROOT_CXX=y

# ── Bootloader: U-Boot ───────────────────────────────────────────────────────
BR2_TARGET_UBOOT=y
BR2_TARGET_UBOOT_BUILD_SYSTEM_KCONFIG=y
BR2_TARGET_UBOOT_BOARD_DEFCONFIG="am335x_evm"
BR2_TARGET_UBOOT_FORMAT_IMG=y
BR2_TARGET_UBOOT_SPL=y
BR2_TARGET_UBOOT_SPL_NAME="MLO"
BR2_TARGET_UBOOT_NEEDS_DTC=y

# ── Kernel ───────────────────────────────────────────────────────────────────
BR2_LINUX_KERNEL=y
BR2_LINUX_KERNEL_CUSTOM_VERSION=y
BR2_LINUX_KERNEL_CUSTOM_VERSION_VALUE="6.6.30"
BR2_LINUX_KERNEL_DEFCONFIG="omap2plus"
BR2_LINUX_KERNEL_CONFIG_FRAGMENT_FILES="$(BR2_EXTERNAL_RAPIDBEAGLE_PATH)/board/rapidbeagle/pocketbeagle/linux-fragment.config"
BR2_LINUX_KERNEL_DTS_SUPPORT=y
BR2_LINUX_KERNEL_INTREE_DTS_NAME="am335x-pocketbeagle"
BR2_LINUX_KERNEL_ZIMAGE=y
BR2_LINUX_KERNEL_NEEDS_HOST_OPENSSL=y

# ── Init system ──────────────────────────────────────────────────────────────
BR2_INIT_BUSYBOX=y

# ── Filesystem ───────────────────────────────────────────────────────────────
BR2_TARGET_ROOTFS_EXT2=y
BR2_TARGET_ROOTFS_EXT2_4=y
BR2_TARGET_ROOTFS_EXT2_SIZE="240M"
BR2_TARGET_ROOTFS_TAR=y

# ── /dev management: devtmpfs (mounted by kernel, BusyBox manages it) ───────
BR2_ROOTFS_DEVICE_CREATION_DYNAMIC_DEVTMPFS=y

# ── System config ────────────────────────────────────────────────────────────
BR2_TARGET_GENERIC_HOSTNAME="rapidbeagle"
BR2_TARGET_GENERIC_ISSUE="Welcome to RapidBeagle"
BR2_TARGET_GENERIC_GETTY=y
BR2_TARGET_GENERIC_GETTY_PORT="ttyS0"
BR2_TARGET_GENERIC_GETTY_BAUDRATE_115200=y
BR2_SYSTEM_BIN_SH_BASH=n
BR2_SYSTEM_DEFAULT_PATH="/usr/bin:/usr/sbin:/bin:/sbin"
BR2_TARGET_GENERIC_ROOT_PASSWD=""

# ── Rootfs overlay (our custom files) ────────────────────────────────────────
BR2_ROOTFS_OVERLAY="$(BR2_EXTERNAL_RAPIDBEAGLE_PATH)/board/rapidbeagle/pocketbeagle/rootfs-overlay"

# ── Custom inittab and interfaces (override BusyBox defaults) ───────────────
BR2_PACKAGE_BUSYBOX_INDIVIDUAL_BINARIES=n
BR2_PACKAGE_BUSYBOX_SHOW_OTHERS=n
BR2_PACKAGE_BUSYBOX=y

# ── Post-build / post-image hooks ────────────────────────────────────────────
BR2_ROOTFS_POST_BUILD_SCRIPT="$(BR2_EXTERNAL_RAPIDBEAGLE_PATH)/board/rapidbeagle/pocketbeagle/post-build.sh"
BR2_ROOTFS_POST_IMAGE_SCRIPT="$(BR2_EXTERNAL_RAPIDBEAGLE_PATH)/board/rapidbeagle/pocketbeagle/post-image.sh"

# ── genimage host package (for SD image assembly) ───────────────────────────
BR2_PACKAGE_HOST_GENIMAGE=y

# ── Userspace packages ───────────────────────────────────────────────────────
# OpenSSH for dev access
BR2_PACKAGE_OPENSSH=y
BR2_PACKAGE_OPENSSH_KEY_UTILS=y
BR2_PACKAGE_OPENSSH_SERVER=y
BR2_PACKAGE_OPENSSH_CLIENT=y

# wpa_supplicant for WiFi (dotnet app drives via control socket)
BR2_PACKAGE_WPA_SUPPLICANT=y
BR2_PACKAGE_WPA_SUPPLICANT_NL80211=y
BR2_PACKAGE_WPA_SUPPLICANT_CTRL_IFACE=y
BR2_PACKAGE_WPA_SUPPLICANT_CLI=y

# Wireless tools
BR2_PACKAGE_IW=y

# CA certificates for HTTPS calls from the app
BR2_PACKAGE_CA_CERTIFICATES=y

# Time zone data
BR2_PACKAGE_TZDATA=y
BR2_PACKAGE_TZDATA_ZONELIST="UTC America/Chicago Etc/UTC"

# Network ifupdown scripts (for /etc/network/interfaces support)
BR2_PACKAGE_IFUPDOWN_SCRIPTS=y

# Network basics
BR2_PACKAGE_NETBASE=y
BR2_PACKAGE_BUSYBOX_SHOW_OTHERS=n
```

## buildroot/external/package/rtl8812au/Config.in
```kconfig
config BR2_PACKAGE_RTL8812AU
	bool "rtl8812au (out-of-tree)"
	depends on BR2_LINUX_KERNEL
	depends on BR2_TOOLCHAIN_HAS_THREADS
	help
	  Out-of-tree driver for Realtek RTL8811AU / RTL8812AU /
	  RTL8814AU / RTL8821AU USB WiFi chipsets — covers most "AC"
	  USB dongles (Edimax AC600, Alfa AWUS036ACH, etc.) that
	  mainline Linux does NOT support.

	  Sourced from https://github.com/aircrack-ng/rtl8812au — the
	  most actively maintained fork.

	  Module name produced: 88XXau.ko
	  Load with: modprobe 88XXau
```
